#include <Wire.h>
#include <Adafruit_SSD1306.h>
#include <Adafruit_GFX.h>
#include <Adafruit_BMP280.h>
#include <AHT20.h>

Adafruit_BMP280 bmp; // Cria o elemento "BMP280"
AHT20 aht;
// Define a largura e altura do display (128x32)
Adafruit_SSD1306 display;
// 128x32 px, horizontal byte order, MSB first, 512 bytes

#define BT 17
#define BT1 16
#define led 18

int i=0;

const unsigned char PROGMEM bitmap[] = {
  0x01, 0xC0, 0x06, 0x1F, 0x01, 0x80, 0x01, 0xFE, 0x00, 0x00, 0x00, 0x00, 0x00, 0x00, 0x04, 0x00,
  0x00, 0x30, 0x0C, 0x31, 0xC3, 0x80, 0x02, 0x03, 0x06, 0x00, 0x00, 0x00, 0x1E, 0x00, 0x7F, 0xC0,
  0x00, 0x10, 0x18, 0x20, 0xC3, 0x80, 0x06, 0x41, 0x03, 0x0F, 0x80, 0x00, 0x13, 0x00, 0x0E, 0x00,
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  0x00, 0x00, 0x00, 0x00, 0x00, 0x00, 0x00, 0x00, 0x00, 0x00, 0x00, 0x00, 0x00, 0x00, 0x04, 0x00
};
void setup() {
  
  Serial.begin(115200);

  Wire.begin (21,22);
  
  display.begin(SSD1306_SWITCHCAPVCC, 0x3C);
 
  if (!bmp.begin(0x77))
  {
    Serial.println("BMP280 não encontrado");
    while(1) delay(10);
  }

  display.clearDisplay();

  display.drawBitmap(0, 0, bitmap, 128, 32, WHITE);

  display.display();
  delay(5000);
  
  pinMode(BT, INPUT_PULLUP);
  pinMode(BT1, INPUT_PULLUP);
  pinMode(led, OUTPUT);
 
}

void loop() {
  // put your main code here, to run repeatedly:
  display.setTextColor(WHITE);
  display.setTextSize(1);

  int valBT = 0;
  int valBT1 = 0;

  valBT = digitalRead(BT);
  valBT1 = digitalRead(BT1);

  if (i>1){
    i = (i+1) - i;
  }

 if (i<0){
    i = (i*(-1)) - i;
  }


  if (valBT == LOW){
    i= i + 1;
  }

  if (valBT1 == LOW){
    i= i - 1;
  }

  float humidade=aht.getHumidity();
  float temperatura=bmp.readTemperature();
  float pressão=bmp.readPressure();

  Serial.println(bmp.readTemperature());
  Serial.println(bmp.readPressure());
  if (i == 1){
    display.clearDisplay();
    display.setCursor(0,0);
    display.print("Temperatura: ");
    display.print(temperatura);
    display.setCursor(0,10);
    display.print("Humidade: ");
    display.print(humidade);
    display.display();
    digitalWrite(led, HIGH);
  }

  if (i == 0){
    display.clearDisplay();
    display.setCursor(0,0);
    display.print("Pressão: ");
    display.print(pressão);
    display.setCursor(0,10);
    display.print("Altitude: 800m");
    display.display();
    digitalWrite(led, LOW);
  }
  
  delay(10);

}
