#include <Wire.h>
#include <Adafruit_SSD1306.h>
#include <Adafruit_GFX.h>
#include <AHT20.h>
#include <Adafruit_BMP280.h>
#include <Adafruit_MPU6050.h>
#include <Adafruit_INA219.h>

Adafruit_INA219 ina;
Adafruit_BMP280 bmp; // Cria o elemento "BMP280"
AHT20 aht;
Adafruit_MPU6050 mpu;

#define SDA 6 //PINOS I2C
#define SCL 7

#define BT 0 //BOTOES
#define BT1 1



int i=0; //VARIAVEL DE PAGINAÇÂO. 0=PAGINA INCIAL

// Define a largura e altura do display (128x32)
Adafruit_SSD1306 display;
// 128x32 px, horizontal byte order, MSB first, 512 bytes


const unsigned char PROGMEM bitmap[] = {
  0x01, 0xC0, 0x06, 0x1F, 0x01, 0x80, 0x01, 0xFE, 0x00, 0x00, 0x00, 0x00, 0x00, 0x00, 0x04, 0x00,
  0x00, 0x30, 0x0C, 0x31, 0xC3, 0x80, 0x02, 0x03, 0x06, 0x00, 0x00, 0x00, 0x1E, 0x00, 0x7F, 0xC0,
  0x00, 0x10, 0x18, 0x20, 0xC3, 0x80, 0x06, 0x41, 0x03, 0x0F, 0x80, 0x00, 0x13, 0x00, 0x0E, 0x00,
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  0x00, 0x00, 0x00, 0x00, 0x00, 0x00, 0x00, 0x00, 0x00, 0x00, 0x00, 0x00, 0x00, 0x00, 0x04, 0x00
};
void setup() {
  
  Serial.begin(115200);

  Wire.begin (SDA,SCL);
  
  ////////SENSORES (PROVISORIO) ////////////////////
    if (!aht.begin()) 
  {Serial.println (" AHT20 não encontrado");
  while (1) delay (1000);}

  if (!bmp.begin(0x77))
  { Serial.println("BMP280 não encontrado");
    while(1) delay(10);}

  if(!mpu.begin())
    {Serial.println ("MPU não encontrado!");
    while (1) delay (1000);}
 
    if (!ina.begin ())
  {Serial.println("Ina não encontrado");
  while (1) delay (1000);}

  ///////////DISPLAY////////////////////////////////
  display.begin(SSD1306_SWITCHCAPVCC, 0x3C);
 
  display.clearDisplay();

  display.drawBitmap(0, 0, bitmap, 128, 32, WHITE);

  display.display();
  delay(5000);
  /////////////////////////////////////////////////

  /////BOTOES/////////////////////
  pinMode(BT, INPUT_PULLUP);
  pinMode(BT1, INPUT_PULLUP);
  ///////////////////////////////
}

void loop() {
  // put your main code here, to run repeatedly:
  LCD();
  delay(100);

}

void LCD(){
    
    display.clearDisplay();
    display.setTextColor(WHITE);
    display.setTextSize(1);
 
  //////////PAGINAÇÂO///////////////////  
  int valBT = 0;
  int valBT1 = 0;

  valBT = digitalRead(BT);
  valBT1 = digitalRead(BT1);
  
  if (i>6){
    i = 0;
  }

  if (i<0){
    i = 6;
  }


  if (valBT == LOW){
    i= i + 1;
  }

  if (valBT1 == LOW){
    i= i - 1;
  }
  //////////////////////////////////////


  /////DISING///////////////////////////
  if(i == 0){ 
    cabeca();
    pag0();
    display.clearDisplay();
  }

  if(i == 1){  
    cabeca();
    pag1();
    display.clearDisplay();
  } 

  if(i == 2){ 
    cabeca();
    pag2();
    display.clearDisplay();
  }

  if(i == 3){ 
    cabeca();
    pag3();
    display.clearDisplay();
  }

  if(i == 4){ 
    cabeca();
    pag4();
    display.clearDisplay();
  }

  if(i == 5){ 
    cabeca();
    pag5();
    display.clearDisplay();
  }

  if(i == 6){ 
    cabeca();
    pag6();
    display.clearDisplay();
  }
  //////////////////////////////////////////////
}


void cabeca (){

  display.setCursor(0,0);
  display.print("BAT1: 28g - BAT2: 27g");
}


void pag0() {
    
    display.setCursor(0,10);
    display.print("Temperatura: ");
    display.print(bmp.readTemperature());
    display.setCursor(0,20);
    display.print("Humidade:");
    display.print(aht.getHumidity());
    display.display();

}

void pag1() {
    
    display.setCursor(0,10);
    display.print("Pressao: ");
    display.print(bmp.readPressure()/100);
    display.print(" hPa");
    display.setCursor(0,20);
    display.print("Altitude: ");
    display.print(bmp.readAltitude(1013.25));
    display.print(" m");
    display.display();

}

void pag2() {
    
    sensors_event_t ace, giro, temp;
    mpu.getEvent (&ace, &giro, &temp);
    
    display.setCursor(0,10);
    display.print("Accel X: ");
    display.print(ace.acceleration.x);
    display.setCursor(0,20);
    display.print("Gyro X: ");
    display.print(giro.gyro.x);
    display.display();

}

void pag3() {
    
    sensors_event_t ace, giro, temp;
    mpu.getEvent (&ace, &giro, &temp);
    
    display.setCursor(0,10);
    display.print("Accel Y: ");
    display.print(ace.acceleration.y);
    display.setCursor(0,20);
    display.print("Gyro Y: ");
    display.print(giro.gyro.y);
    display.display();

}

void pag4() {
    
    sensors_event_t ace, giro, temp;
    mpu.getEvent (&ace, &giro, &temp);

    display.setCursor(0,10);
    display.print("Accel Z: ");
    display.print(ace.acceleration.z);
    display.setCursor(0,20);
    display.print("Gyro Z: ");
    display.print(giro.gyro.z);
    display.display();

}

void pag5() {
    
    display.setCursor(0,10);
    display.print("Consumo: ");
    display.print(ina.getCurrent_mA());
    display.setCursor(0,20);
    display.print("Potencia: ");
    display.print(ina.getPower_mW());
    display.display();

}

void pag6() {
    
    display.setCursor(0,10);
    display.print("R/S: ");
    display.print("CanSat_Helena");
    display.setCursor(0,20);
    display.print("IP: ");
    display.print("192.168.22.0");
    display.display();

}
